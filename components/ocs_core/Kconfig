## components/ocs_core/Kconfig
```kconfig
menu "OCS Core Configuration"
    config OCS_CORE_FW_VERSION
        string "Firmware Version"
        default "0.0.0"
        help
            Firmware version in SemVer format.

    config OCS_CORE_FW_NAME
        string "Firmware Name"
        default "firmware"
        help
            Firmware name.

    config OCS_CORE_FW_DESCRIPTION
        string "Firmware Description"
        default "firmware"
        help
            Firmware description.
endmenu
```

## components/ocs_http/Kconfig
```kconfig
menu "OCS HTTP Server Configuration"
    config OCS_HTTP_SERVER_PORT
        int "Server Port"
        default 80
        help
            TCP port to accept incoming connections.

    config OCS_HTTP_SERVER_MAX_URI_HANDLERS
        int "Maximum number of URI handlers"
        default 64
        help
            Maximum number of URI handlers that can be registered for an HTTP server.
endmenu
```

## components/ocs_iot/Kconfig
```kconfig
menu "OCS IoT Configuration"
    menu "OCS HTTP Pipeline Configuration"
        config OCS_IOT_HTTP_PIPELINE_TELEMETRY_BUFFER_SIZE
            int "Buffer size to hold the formatted telemetry JSON data"
            default 512
            help
                Buffer size to hold the formatted telemetry JSON data, in bytes.

        config OCS_IOT_HTTP_PIPELINE_REGISTRATION_BUFFER_SIZE
            int "Buffer size to hold the formatted registration JSON data"
            default 256
            help
                Buffer size to hold the formatted registration JSON data, in bytes.

        config OCS_IOT_HTTP_PIPELINE_COMMANDS_BUFFER_SIZE
            int "Buffer size to hold the formatted commands JSON data"
            default 256
            help
                Buffer size to hold the formatted commands JSON data, in bytes.
    endmenu

    menu "OCS Console Pipeline Configuration"
        config OCS_IOT_CONSOLE_PIPELINE_ENABLE
            bool "Periodically dump data to the console"
            default n
            help
                Enable periodic dumping of telemetry and registration data to the console.

        config OCS_IOT_CONSOLE_PIPELINE_TELEMETRY_INTERVAL
            int "How often to dump the telemetry data to the console"
            default 10
            depends on OCS_IOT_CONSOLE_PIPELINE_ENABLE
            help
                How often telemetry data is dumped to the console, in seconds.

        config OCS_IOT_CONSOLE_PIPELINE_TELEMETRY_BUFFER_SIZE
            int "Buffer size to hold the formatted telemetry JSON data"
            default 512
            depends on OCS_IOT_CONSOLE_PIPELINE_ENABLE
            help
                Buffer size to hold the formatted telemetry JSON data, in bytes.

        config OCS_IOT_CONSOLE_PIPELINE_REGISTRATION_INTERVAL
            int "How often to dump the registration data to the console"
            default 20
            depends on OCS_IOT_CONSOLE_PIPELINE_ENABLE
            help
                How often registration data is dumped to the console, in seconds.

        config OCS_IOT_CONSOLE_PIPELINE_REGISTRATION_BUFFER_SIZE
            int "Buffer size to hold the formatted registration JSON data"
            default 512
            depends on OCS_IOT_CONSOLE_PIPELINE_ENABLE
            help
                Buffer size to hold the formatted registration JSON data, in bytes.
    endmenu
endmenu
```

## components/ocs_net/Kconfig
```kconfig
menu "OCS Network Configuration"
    menu "WiFi Configuration"
        menu "STA Configuration"
            config OCS_NETWORK_WIFI_STA_RETRY_COUNT
                int "WiFi Retry Count"
                default 5
                help
                    Maximum number of attempts to establish a WiFi connection.
        endmenu

        menu "AP Configuration"
            config OCS_NETWORK_WIFI_AP_CHANNEL
                int "WiFi Channel"
                range 1 13
                default 1
                help
                    WiFi channel (network channel).

            config OCS_NETWORK_WIFI_AP_MAX_CONN
                int "Maximum number of STA connections"
                default 7
                help
                    Maximum number of the STA connects to AP.
        endmenu
    endmenu
endmenu
```

## components/ocs_sensor/Kconfig
```kconfig
menu "OCS Sensor Configuration"
    menu "YL-69 Sensor Configuration"
        config OCS_SENSOR_YL69_ENABLE
            bool "Enable YL-69 sensor"
            default y
            help
                Enable YL-69 sensor.

        config OCS_SENSOR_YL69_ADC_CHANNEL
            int "YL-69 sensor ADC channel"
            default 6
            depends on OCS_SENSOR_YL69_ENABLE
            help
                ADC channel to read the soil moisture values.

        config OCS_SENSOR_YL69_VALUE_MAX
            int "YL-69 sensor soil dryness threshold"
            default 700
            depends on OCS_SENSOR_YL69_ENABLE
            help
                Value of completely dry soil.

        config OCS_SENSOR_YL69_VALUE_MIN
            int "YL-69 sensor soil wetness threshold"
            default 300
            depends on OCS_SENSOR_YL69_ENABLE
            help
                Value of completely wet soil.

        config OCS_SENSOR_YL69_RELAY_GPIO
            int "YL-69 sensor relay control GPIO"
            default 26
            depends on OCS_SENSOR_YL69_ENABLE
            help
                GPIO to control the relay.

        config OCS_SENSOR_YL69_READ_INTERVAL
            int "YL-69 sensor read interval, in seconds"
            default 86400
            depends on OCS_SENSOR_YL69_ENABLE
            help
                How often to read data from the sensor.

        config OCS_SENSOR_YL69_POWER_ON_DELAY_INTERVAL
            int "YL-69 sensor power on delay interval, in seconds"
            default 1
            depends on OCS_SENSOR_YL69_ENABLE
            help
                How long to wait after the relay is energized.
    endmenu

    menu "LDR Sensor Configuration"
        config OCS_SENSOR_LDR_ENABLE
            bool "Enable LDR sensor"
            default y
            help
                Enable LDR sensor.

        config OCS_SENSOR_LDR_ADC_CHANNEL
            int "LDR sensor ADC channel"
            default 5
            depends on OCS_SENSOR_LDR_ENABLE
            help
                ADC channel to read the LDR value.

        config OCS_SENSOR_LDR_VALUE_MAX
            int "LDR sensor complete lightness value"
            default 950
            depends on OCS_SENSOR_LDR_ENABLE
            help
                Value of complete lightness.

        config OCS_SENSOR_LDR_VALUE_MIN
            int "LDR sensor complete darkness value"
            default 50
            depends on OCS_SENSOR_LDR_ENABLE
            help
                Value of complete darkness.

        config OCS_SENSOR_LDR_READ_INTERVAL
            int "LDR sensor read interval, in seconds"
            default 5
            depends on OCS_SENSOR_LDR_ENABLE
            help
                How often to read the lightness value.
    endmenu
endmenu
```

## sdkconfig.defaults
```kconfig
CONFIG_ESPTOOLPY_FLASHSIZE_4MB=y
CONFIG_PARTITION_TABLE_CUSTOM=y
CONFIG_PARTITION_TABLE_CUSTOM_FILENAME="partitions.csv"
CONFIG_PARTITION_TABLE_FILENAME="partitions.csv"
CONFIG_PARTITION_TABLE_OFFSET=0xF000
CONFIG_PARTITION_TABLE_MD5=y

CONFIG_ESP_COREDUMP_ENABLE_TO_FLASH=y
CONFIG_ESP_COREDUMP_DATA_FORMAT_ELF=y
CONFIG_ESP_COREDUMP_CHECKSUM_CRC32=y
CONFIG_ESP_COREDUMP_CHECK_BOOT=y
CONFIG_ESP_COREDUMP_ENABLE=y
CONFIG_ESP_COREDUMP_LOGS=y
CONFIG_ESP_COREDUMP_MAX_TASKS_NUM=64
CONFIG_ESP_COREDUMP_STACK_SIZE=0
```

## tests/main/Kconfig
```kconfig
menu "OCS Tests Configuration"
    menu "Unit Tests Configuration"
        config OCS_TEST_UNIT_WIFI_STA_ENABLED
            bool "Enable/Disable WiFi STA Unit Tests"
            default n

        config OCS_TEST_UNIT_WIFI_STA_SSID
            string "WiFi STA SSID"
            depends on OCS_TEST_UNIT_WIFI_STA_ENABLED
            default "OCS-SSID"

        config OCS_TEST_UNIT_WIFI_STA_PASSWORD
            string "WiFi STA Password"
            depends on OCS_TEST_UNIT_WIFI_STA_ENABLED
            default "OCS-Password"
    endmenu
endmenu
```

## tests/sdkconfig.defaults
```kconfig
CONFIG_UNITY_ENABLE_FLOAT=y
CONFIG_UNITY_ENABLE_DOUBLE=y
CONFIG_UNITY_ENABLE_COLOR=y
CONFIG_UNITY_ENABLE_IDF_TEST_RUNNER=y
CONFIG_UNITY_ENABLE_FIXTURE=y
CONFIG_UNITY_ENABLE_64BIT=y

CONFIG_TASK_WDT=
CONFIG_TASK_WDT_PANIC=y
CONFIG_TASK_WDT_TIMEOUT_S=60

CONFIG_ESPTOOLPY_FLASHSIZE_4MB=y
CONFIG_PARTITION_TABLE_CUSTOM=y
CONFIG_PARTITION_TABLE_CUSTOM_FILENAME="partitions.csv"
CONFIG_PARTITION_TABLE_FILENAME="partitions.csv"
CONFIG_PARTITION_TABLE_OFFSET=0xF000
CONFIG_PARTITION_TABLE_MD5=y

CONFIG_ESP_COREDUMP_ENABLE_TO_FLASH=y
CONFIG_ESP_COREDUMP_DATA_FORMAT_ELF=y
CONFIG_ESP_COREDUMP_CHECKSUM_CRC32=y
CONFIG_ESP_COREDUMP_CHECK_BOOT=y
CONFIG_ESP_COREDUMP_ENABLE=y
CONFIG_ESP_COREDUMP_LOGS=y
CONFIG_ESP_COREDUMP_MAX_TASKS_NUM=64
CONFIG_ESP_COREDUMP_STACK_SIZE=0

CONFIG_FREERTOS_USE_TRACE_FACILITY=y
CONFIG_FREERTOS_VTASKLIST_INCLUDE_COREID=y
CONFIG_FREERTOS_GENERATE_RUN_TIME_STATS=y
CONFIG_FREERTOS_RUN_TIME_COUNTER_TYPE_U64=y
```

## tools/ds-rom-code-scanner/main/Kconfig
```kconfig
menu "Dallas Semiconductor Rom Code Scanner"
    config OCS_TOOLS_ROM_CODE_SCANNER_RESULT_BUFFER_SIZE
        int "Buffer size to store the formatted scan result, in bytes"
        default 1024

    config OCS_TOOLS_ROM_CODE_SCANNER_GPIO
        int "1-Wire bus GPIO"
        default 27
        help
            1-Wire bus GPIO.

    config OCS_TOOLS_ROM_CODE_SCANNER_RESET_PULSE_INTERVAL
        int "Reset pulse duration, in microseconds"
        default 480

    config OCS_TOOLS_ROM_CODE_SCANNER_PRESENCE_PULSE_INTERVAL
        int "Presence pulse duration, in microseconds"
        default 60

    config OCS_TOOLS_ROM_CODE_SCANNER_WRITE_SLOT_INTERVAL
        int "Write slot duration, in microseconds"
        default 60

    config OCS_TOOLS_ROM_CODE_SCANNER_WRITE_BIT_INTERVAL
        int "Write bit duration, in microseconds"
        default 10

    config OCS_TOOLS_ROM_CODE_SCANNER_WRITE_RECOVERY_INTERVAL
        int "Write recovery duration, in microseconds"
        default 1

    config OCS_TOOLS_ROM_CODE_SCANNER_READ_SLOT_INTERVAL
        int "Read slot duration, in microseconds"
        default 60

    config OCS_TOOLS_ROM_CODE_SCANNER_READ_BIT_INIT_INTERVAL
        int "Read bit INIT duration, in microseconds"
        default 5

    config OCS_TOOLS_ROM_CODE_SCANNER_READ_BIT_RC_INTERVAL
        int "Read bit RC duration, in microseconds"
        default 5

    config OCS_TOOLS_ROM_CODE_SCANNER_READ_RECOVERY_INTERVAL
        int "Read bit recovery interval, in microseconds"
        default 1
endmenu
```

## tools/ds18b20-verifier/main/Kconfig
```kconfig
menu "Dallas Semiconductor DS18B20 Sensor Verification"
    config OCS_TOOLS_DS18B20_VERIFIER_RESULT_BUFFER_SIZE
        int "Buffer size to store the formatted verification result, in bytes"
        default 1024

    config OCS_TOOLS_DS18B20_VERIFIER_GPIO
        int "1-Wire bus GPIO"
        default 27
        help
            1-Wire bus GPIO.

    config OCS_TOOLS_DS18B20_VERIFIER_TOTAL_ATTEMPTS
        int "Number of attempts to read temperature"
        default 15
        help
            Number of times to read the temperature value from the sensor.

    config OCS_TOOLS_DS18B20_VERIFIER_DELAY
        int "Delay after each temperature reading, in seconds"
        default 1
        help
            Number of seconds to wait after each temperature reading.

    config OCS_TOOLS_DS18B20_VERIFIER_RESET_PULSE_INTERVAL
        int "Reset pulse duration, in microseconds"
        default 480

    config OCS_TOOLS_DS18B20_VERIFIER_PRESENCE_PULSE_INTERVAL
        int "Presence pulse duration, in microseconds"
        default 60

    config OCS_TOOLS_DS18B20_VERIFIER_WRITE_SLOT_INTERVAL
        int "Write slot duration, in microseconds"
        default 60

    config OCS_TOOLS_DS18B20_VERIFIER_WRITE_BIT_INTERVAL
        int "Write bit duration, in microseconds"
        default 10

    config OCS_TOOLS_DS18B20_VERIFIER_WRITE_RECOVERY_INTERVAL
        int "Write recovery duration, in microseconds"
        default 1

    config OCS_TOOLS_DS18B20_VERIFIER_READ_SLOT_INTERVAL
        int "Read slot duration, in microseconds"
        default 60

    config OCS_TOOLS_DS18B20_VERIFIER_READ_BIT_INIT_INTERVAL
        int "Read bit INIT duration, in microseconds"
        default 5

    config OCS_TOOLS_DS18B20_VERIFIER_READ_BIT_RC_INTERVAL
        int "Read bit RC duration, in microseconds"
        default 5

    config OCS_TOOLS_DS18B20_VERIFIER_READ_RECOVERY_INTERVAL
        int "Read bit recovery interval, in microseconds"
        default 1
endmenu
```

## tools/sht41-verifier/main/Kconfig
```kconfig
menu "Senserion SHT41 Sensor Verification"
    config OCS_TOOLS_SHT41_VERIFIER_TOTAL_ATTEMPTS
        int "Number of attempts to read sensor data"
        default 15
        help
            Number of times to read the data from the sensor.

    config OCS_TOOLS_SHT41_VERIFIER_DELAY_INTERVAL
        int "Delay after each sensor reading, in seconds"
        default 1
        help
            Number of seconds to wait after each sensor reading.

    config OCS_TOOL_SHT41_VERIFIER_I2C_MASTER_SDA_GPIO
        int "I2C master SDA GPIO"
        default 21
        help
            I2C master SDA GPIO.

    config OCS_TOOL_SHT41_VERIFIER_I2C_MASTER_SCL_GPIO
        int "I2C master SCL GPIO"
        default 22
        help
            I2C master SCL GPIO.

    config OCS_TOOLS_SHT41_VERIFIER_I2C_SEND_WAIT_INTERVAL
        int "How long to wait before receiving the operation result from the I2C device"
        default 10
        help
            Interval to wait before receiving the operation result from the I2C device, in ms.
endmenu
```
